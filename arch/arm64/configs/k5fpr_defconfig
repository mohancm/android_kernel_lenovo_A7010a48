## arch/arm64/mach-mtk/Kconfig
```kconfig
menu "MTK Board Configure"

config ARCH_MTK_FLORIDA_BOARD
      tristate "MTK Platform sound board Configure"
      help 
           To add board for Soc audio on MTK Platform

endmenu
   
      
```

## drivers/misc/mediatek/alsps/epl8801/Kconfig
```kconfig
config MTK_EPL8801
	bool "MTK_EPL8801 for MediaTek package"
	default n
	help
	It support different type sensor
	in this platform. If this option
	is set, it will support ambient
	and light sensor MTK_8801.
```

## drivers/misc/mediatek/flashlight/Kconfig
```kconfig
config MTK_FLASHLIGHT
  bool CONFIG_MTK_FLASHLIGHT
  default n
  help
    CONFIG_MTK_FLASHLIGHT

config CUSTOM_KERNEL_FLASHLIGHT
        string "CUSTOM_KERNEL_FLASHLIGHT"
        help
          Kernel space cameara flashlight driver. You can use this driver
          choose cameara flashlight type.
	  
#lenovo.sw START wuyt3 config k5  camera
config LENOVO_TORCH_MODE
	bool "LENOVO_TORCH_MODE"
	default n
#lenovo.sw end wuyt3 config k5  camera	
```

## drivers/misc/mediatek/gyroscope/lsm6ds3gy/Kconfig
```kconfig
config MTK_LSM6DS3GY
    bool "MTK_LSM6DS3GY for MediaTek package"
    default n
```

## drivers/misc/mediatek/magnetometer/mxg2320/Kconfig
```kconfig
config MTK_MXG2320
	bool "MXG2320 for MediaTek package"
	default n
	help
	  It support different magnetometer sensor.
          If this option is set,
	  it will support
          MXG2320D magnetometer.
```
